## firmware/main/Kconfig.projbuild
```kconfig
menu "NRF24 Link Monitor"

    config NRF24_SIM_MODE
        bool "Simulation mode (no NRF24 transmitter needed)"
        default n
        help
            When enabled, the firmware generates synthetic packets internally
            instead of reading from the NRF24L01. Cycles NORMAL → WEAK →
            INTERFERENCE every 20 s. No transmitter hardware required.

endmenu
```

## firmware/sdkconfig.defaults
```kconfig
CONFIG_ESP_CONSOLE_UART_DEFAULT=y
CONFIG_PARTITION_TABLE_CUSTOM=y
CONFIG_PARTITION_TABLE_CUSTOM_FILENAME="partitions.csv"
CONFIG_PARTITION_TABLE_OFFSET=0x8000
CONFIG_ESP_MAIN_TASK_STACK_SIZE=8192
CONFIG_ESP_WIFI_IRAM_OPT=n
CONFIG_ESP_WIFI_RX_IRAM_OPT=n
```
