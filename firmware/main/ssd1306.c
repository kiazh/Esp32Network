#include "ssd1306.h"
#include "driver/i2c.h"
#include "driver/gpio.h"
#include "freertos/FreeRTOS.h"
#include "freertos/task.h"
#include <string.h>
#include <stdint.h>

#define I2C_PORT    I2C_NUM_0
#define I2C_SDA     GPIO_NUM_21
#define I2C_SCL     GPIO_NUM_22
#define I2C_FREQ_HZ 400000

/* 5-column (5×7) bitmap font, ASCII 0x20–0x7E.
 * Each byte encodes one column: bit0=top pixel … bit6=bottom pixel. */
static const uint8_t FONT[][5] = {
    {0x00,0x00,0x00,0x00,0x00}, /* 0x20   */
    {0x00,0x00,0x5f,0x00,0x00}, /* 0x21 ! */
    {0x00,0x07,0x00,0x07,0x00}, /* 0x22 " */
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    {0x10,0x08,0x08,0x10,0x08}, /* 0x7e ~ */
};

/* ── Low-level I2C write ─────────────────────────────────────────────────── */

static bool s_ok = false;

static void cmd(uint8_t c)
{
    uint8_t buf[2] = {0x00, c};
    i2c_master_write_to_device(I2C_PORT, SSD1306_I2C_ADDR, buf, 2,
                               pdMS_TO_TICKS(50));
}

/* ── Public API ─────────────────────────────────────────────────────────── */

esp_err_t ssd1306_init(void)
{
    i2c_config_t cfg = {
        .mode             = I2C_MODE_MASTER,
        .sda_io_num       = I2C_SDA,
        .scl_io_num       = I2C_SCL,
        .sda_pullup_en    = GPIO_PULLUP_ENABLE,
        .scl_pullup_en    = GPIO_PULLUP_ENABLE,
        .master.clk_speed = I2C_FREQ_HZ,
    };
    esp_err_t ret = i2c_param_config(I2C_PORT, &cfg);
    if (ret != ESP_OK) return ret;
    ret = i2c_driver_install(I2C_PORT, I2C_MODE_MASTER, 0, 0, 0);
    if (ret != ESP_OK) return ret;

    vTaskDelay(pdMS_TO_TICKS(10));

    /* Try a NOP to see if the device is present */
    uint8_t probe = 0x00;
    ret = i2c_master_write_to_device(I2C_PORT, SSD1306_I2C_ADDR,
                                     &probe, 1, pdMS_TO_TICKS(50));
    if (ret != ESP_OK) return ret;

    /* Initialisation sequence */
    static const uint8_t INIT[] = {
        0xAE,        /* display off */
        0xD5, 0x80,  /* clock: div=1, fosc=8 */
        0xA8, 0x3F,  /* mux ratio = 64 */
        0xD3, 0x00,  /* display offset = 0 */
        0x40,        /* start line = 0 */
        0x8D, 0x14,  /* charge pump ON */
        0x20, 0x00,  /* horizontal addressing mode */
        0xA1,        /* col 127 → SEG0 (mirror) */
        0xC8,        /* COM scan: COM63 → COM0 */
        0xDA, 0x12,  /* COM pins: alt, no remap */
        0x81, 0xCF,  /* contrast */
        0xD9, 0xF1,  /* pre-charge */
        0xDB, 0x40,  /* VCOMH deselect = 0.77 Vcc */
        0xA4,        /* output follows GDDRAM */
        0xA6,        /* normal polarity */
        0xAF,        /* display on */
    };
    for (size_t i = 0; i < sizeof(INIT); i++) cmd(INIT[i]);

    s_ok = true;
    ssd1306_clear();
    return ESP_OK;
}

void ssd1306_clear(void)
{
    if (!s_ok) return;
    /* Set full display address window */
    cmd(0x21); cmd(0); cmd(127);   /* col 0–127 */
    cmd(0x22); cmd(0); cmd(7);     /* page 0–7 */

    /* Stream 1024 zero bytes as data, 16 bytes per I2C transaction */
    uint8_t buf[17];
    buf[0] = 0x40;
    memset(buf + 1, 0x00, 16);
    for (int i = 0; i < 64; i++)
        i2c_master_write_to_device(I2C_PORT, SSD1306_I2C_ADDR,
                                   buf, 17, pdMS_TO_TICKS(100));
}

void ssd1306_print_line(uint8_t row, const char *text)
{
    if (!s_ok || row >= SSD1306_PAGES) return;

    cmd(0x22); cmd(row); cmd(row);    /* page range */
    cmd(0x21); cmd(0);   cmd(127);    /* column 0–127 */

    /* Render text, 6 px/char, stream data via I2C in 16-byte chunks */
    uint8_t buf[17];
    buf[0] = 0x40;
    int bi  = 1;
    int col = 0;

#define PUSH(byte) do {                                                       \
        buf[bi++] = (byte); col++;                                            \
        if (bi == 17) {                                                       \
            i2c_master_write_to_device(I2C_PORT, SSD1306_I2C_ADDR,           \
                                       buf, 17, pdMS_TO_TICKS(100));          \
            buf[0] = 0x40; bi = 1;                                            \
        }                                                                     \
    } while (0)

    for (int ci = 0; text[ci] && col < 128; ci++) {
        uint8_t ch = (uint8_t)text[ci];
        const uint8_t *g = (ch >= 0x20 && ch <= 0x7e) ? FONT[ch - 0x20] : FONT[0];
        for (int b = 0; b < 5 && col < 128; b++) PUSH(g[b]);
        if (col < 128) PUSH(0x00);
    }
    while (col < 128) PUSH(0x00);
    if (bi > 1) i2c_master_write_to_device(I2C_PORT, SSD1306_I2C_ADDR,
                                            buf, bi, pdMS_TO_TICKS(100));
#undef PUSH
}
